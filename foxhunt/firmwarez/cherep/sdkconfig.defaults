## foxhunt/firmwarez/cherep/sdkconfig.defaults
```kconfig
CONFIG_ESP_SYSTEM_EVENT_TASK_STACK_SIZE=4096
CONFIG_FREERTOS_HZ=1000
CONFIG_FREERTOS_USE_TICKLESS_IDLE=n

# mbedTLS — нужен для HMAC-SHA256
CONFIG_MBEDTLS_HMAC_DRBG_ENABLED=y
CONFIG_MBEDTLS_SHA256_C=y

# WiFi
CONFIG_ESP_WIFI_STATIC_RX_BUFFER_NUM=10
CONFIG_ESP_WIFI_DYNAMIC_RX_BUFFER_NUM=32
CONFIG_ESP_WIFI_TX_BUFFER_TYPE=1

# HTTP server
CONFIG_HTTPD_MAX_REQ_HDR_LEN=1024
CONFIG_HTTPD_MAX_URI_LEN=512

# Логи
CONFIG_LOG_DEFAULT_LEVEL_INFO=y

# Размер стека главной задачи
CONFIG_ESP_MAIN_TASK_STACK_SIZE=8192

# NVS шифрование выключено (можно включить позже)
CONFIG_NVS_ENCRYPTION=n

# Flash
CONFIG_ESPTOOLPY_FLASHSIZE_4MB=y
CONFIG_ESPTOOLPY_FLASHSIZE="4MB"

# Partition table
CONFIG_PARTITION_TABLE_CUSTOM=y
CONFIG_PARTITION_TABLE_CUSTOM_FILENAME="partitions.csv"
```

## foxhunt/work/Checkpoint/test_wifi_config/sdkconfig.defaults
```kconfig
# Flash
CONFIG_ESPTOOLPY_FLASHSIZE_4MB=y
CONFIG_ESPTOOLPY_FLASHSIZE="4MB"

# WiFi AP поддержка
CONFIG_ESP_WIFI_SOFTAP_SUPPORT=y

# Логи: INFO уровень
CONFIG_LOG_DEFAULT_LEVEL_INFO=y

# Стек HTTP сервера
CONFIG_HTTPD_MAX_REQ_HDR_LEN=1024
```
